## meta-pyro-updates/conf/layer.conf
```bitbake
# We have a conf and classes directory, add to BBPATH
BBPATH .= ":${LAYERDIR}"

# We have recipes-* directories, add to BBFILES
BBFILES += "${LAYERDIR}/poky/recipes-*/*/*.bbappend"

BBFILE_COLLECTIONS += "../meta-pyro-updates"
BBFILE_PATTERN_../meta-pyro-updates = "^${LAYERDIR}/"
BBFILE_PRIORITY_../meta-pyro-updates = "6"
```
